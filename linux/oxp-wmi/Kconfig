## linux/oxp-wmi/Kconfig
```kconfig
# SPDX-License-Identifier: GPL-2.0-or-later

config OXP_WMI
	tristate "OneXPlayer OxpWMI EC (Intel)"
	depends on ACPI_WMI
	depends on HWMON
	depends on DMI
	help
	  WMI client for OneXPlayer Intel handhelds that use
	  SuRwECRegInterface (ecAccessType=2 / OxpWMI).

	  Calls ReadECReg/WriteECReg through the WMI core. Their MOF UInt32
	  input is serialized as a four-byte little-endian WMI method buffer,
	  matching the firmware WMAC ABI. Exposes fan/PWM/CPU temp via hwmon
	  and charge limit / bypass via sysfs.

	  Do not enable this on AMD / WinRing0 boards (oxpec).

	  If unsure, say N.
```
